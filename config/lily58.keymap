#include <behaviors.dtsi>

/ {
    keymap {
        compatible = "zmk,keymap";
        
        default_layer {
            bindings = <
                &kp A &kp B &kp C
            >;
        };
    };
};
